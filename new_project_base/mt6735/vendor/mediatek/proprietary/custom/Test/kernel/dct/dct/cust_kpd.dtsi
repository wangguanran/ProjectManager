/*
 * Generated by MTK SP DrvGen Version 03.13.6 for MT6735M. Copyright MediaTek Inc. (C) 2013.
 * Thu Nov 07 11:17:41 2019
 * Do Not Modify the File.
 */

/**********************************************
 *Keypad DTSI File
********************************************/

&keypad {	
	KPD@ {
		compatible = "mediatek, kpd";
		kpd-key-debounce = <1024>;
		kpd-sw-pwrkey = <116>;
		kpd-hw-pwrkey = <8>;
		kpd-use-extend-type = <0>;
		/*HW Keycode [0~71] -> Linux Keycode*/
		kpd-hw-init-map = <63 88 0 0 0 0 0 0 0 0 4 3 0 106 2 0 108 0 0 10 9 0 158 8 0 105 0 0 7 6 0 28 5 0 103 0 0 523 11 0 65 227 0 66 0 87 0 0 0 0 0 0 0 0 64 60 0 0 0 0 0 0 0 114 115 0 0 0 0 0 0 0 >;
		kpd-pwrkey-eint-gpio = <0>;
		kpd-pwkey-gpio-din  = <0>;
		kpd-hw-dl-key0 = <64>;
		kpd-hw-dl-key1 = <63>;
		kpd-hw-dl-key2 = <8>;
		/*****************************************************************/
		/*******************Uboot Customation***************************/
		/*****************************************************************/
		kpd-hw-recovery-key = <64>;
		kpd-hw-factory-key  = <63>;
	};
};
